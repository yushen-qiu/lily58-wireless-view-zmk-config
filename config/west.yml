## config/west.yml
```yaml
manifest:
  remotes:
    - name: zmkfirmware
      url-base: https://github.com/zmkfirmware
    - name: yushen-qiu
      url-base: https://github.com/yushen-qiu

  projects:
    - name: zmk
      remote: zmkfirmware
      revision: v0.3
      import: app/west.yml
      
    - name: nice-view-custom
      remote: yushen-qiu
      revision: main

  self:
    path: config
```
